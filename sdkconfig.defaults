## sdkconfig.defaults
```kconfig
#
# Arduino
#
CONFIG_ENABLE_ARDUINO_DEPENDS=y
CONFIG_AUTOSTART_ARDUINO=y
CONFIG_ARDUINO_RUN_CORE1=y
CONFIG_ARDUINO_RUNNING_CORE=1
CONFIG_ARDUINO_EVENT_RUN_CORE1=y
CONFIG_ARDUINO_EVENT_RUNNING_CORE=1
CONFIG_ARDUINO_UDP_RUN_CORE1=y
CONFIG_ARDUINO_UDP_RUNNING_CORE=1
CONFIG_ARDUHAL_LOG_DEFAULT_LEVEL_ERROR=y
CONFIG_ARDUHAL_LOG_DEFAULT_LEVEL=1
CONFIG_ARDUHAL_PARTITION_SCHEME_DEFAULT=y
CONFIG_ARDUHAL_PARTITION_SCHEME="default"
CONFIG_MBEDTLS_PSK_MODES=y
CONFIG_MBEDTLS_KEY_EXCHANGE_PSK=y

#
# FreeRTOS
#
CONFIG_FREERTOS_HZ=100
CONFIG_FREERTOS_VTASKLIST_INCLUDE_COREID=y
CONFIG_FREERTOS_USE_TRACE_FACILITY=y
CONFIG_FREERTOS_GENERATE_RUN_TIME_STATS=y

#
# FreeRTOS SystemView Tracing
#
CONFIG_ESP32_APPTRACE_ENABLE=y
CONFIG_SYSVIEW_ENABLE=y
CONFIG_SYSVIEW_TS_SOURCE_TIMER_00=y
CONFIG_SYSVIEW_TS_SOURCE_TIMER_01=
CONFIG_SYSVIEW_TS_SOURCE_TIMER_10=
CONFIG_SYSVIEW_TS_SOURCE_TIMER_11=
CONFIG_SYSVIEW_TS_SOURCE_ESP_TIMER=
CONFIG_SYSVIEW_MAX_TASKS=16
CONFIG_SYSVIEW_BUF_WAIT_TMO=500
CONFIG_SYSVIEW_EVT_OVERFLOW_ENABLE=y
CONFIG_SYSVIEW_EVT_ISR_ENTER_ENABLE=y
CONFIG_SYSVIEW_EVT_ISR_EXIT_ENABLE=y
CONFIG_SYSVIEW_EVT_ISR_TO_SCHEDULER_ENABLE=y
CONFIG_SYSVIEW_EVT_TASK_START_EXEC_ENABLE=y
CONFIG_SYSVIEW_EVT_TASK_STOP_EXEC_ENABLE=y
CONFIG_SYSVIEW_EVT_TASK_START_READY_ENABLE=y
CONFIG_SYSVIEW_EVT_TASK_STOP_READY_ENABLE=y
CONFIG_SYSVIEW_EVT_TASK_CREATE_ENABLE=y
CONFIG_SYSVIEW_EVT_TASK_TERMINATE_ENABLE=y
CONFIG_SYSVIEW_EVT_IDLE_ENABLE=y
CONFIG_SYSVIEW_EVT_TIMER_ENTER_ENABLE=y
CONFIG_SYSVIEW_EVT_TIMER_EXIT_ENABLE=y
```
